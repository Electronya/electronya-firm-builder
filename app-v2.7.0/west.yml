## app-v2.7.0/west.yml
```yaml
# Basic Firmware Manifest
manifest:
  remotes:
    - name: electronya
      url-base: git@github.com:Electronya
    - name: zephyr
      url-base: https://github.com/zephyrproject-rtos

  self:
    path: app

  projects:
    - name: zephyr
      remote: zephyr
      repo-path: zephyr.git
      path: zephir
      revision: zephyr-v2.7.0
      import: true
```

## app-v2.7.3/west.yml
```yaml
# Basic Firmware Manifest
manifest:
  remotes:
    - name: electronya
      url-base: git@github.com:Electronya
    - name: zephyr
      url-base: https://github.com/zephyrproject-rtos

  self:
    path: app

  projects:
    - name: zephyr
      remote: zephyr
      repo-path: zephyr.git
      path: zephyr
      revision: v2.7.3
      import: true
```

## app-v2.7.4/west.yml
```yaml
# Basic Firmware Manifest
manifest:
  remotes:
    - name: electronya
      url-base: git@github.com:Electronya
    - name: zephyr
      url-base: https://github.com/zephyrproject-rtos

  self:
    path: app

  projects:
    - name: zephyr
      remote: zephyr
      repo-path: zephyr.git
      path: zephyr
      revision: zephyr-v2.7.4
      import: true
```
